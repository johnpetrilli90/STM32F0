////////////////////////////////////////////////////////////////////////////////////////////////////////////////////////////////////
/***************************************************** BEGIN IRQn.c ***************************************************************/
////////////////////////////////////////////////////////////////////////////////////////////////////////////////////////////////////
// File:    		IRQn.c
// Description: This file sets up the interrupts used for this project. 
// Author:			John Petrilli & Jack Haller
// Date:				23.Feb.2016
// IP:					
////////////////////////////////////////////////////////////////////////////////////////////////////////////////////////////////////
/**********************************************************************************************************************************/
////////////////////////////////////////////////////////////////////////////////////////////////////////////////////////////////////

#include <stm32f0xx.h>
#include <RTL.h>												//RTOS Library
#include "core_cm0.h"										//Cortex M3 Core header
#include "IRQn.h"												//Interrupt header file
#include "UART.h"												//USART Header File

////////////////////////////////////////////////////////////////////////////////////////////////////////////////////////////////////
/*********************************************** INSERT FUNCTIONS HERE ************************************************************/
////////////////////////////////////////////////////////////////////////////////////////////////////////////////////////////////////

//USART1 Interrupt
void USART1_IRQHandler(void) {					//Handle USART1 Interrupt
	volatile int ISR = USART1->ISR;				//Read the status register
	*pRx = USART1->RDR;										//If read char from data register

	if(ISR & USART_ISR_RXNE){									
		if(*pRx == '@'){
			pRx = &RX[0];											//Set pointer to front of buffer
		}
		else if(*pRx == '?'){
			pRx = &RX[0];											//Set pointer to front of buffer	
			isr_evt_set(0x0001, t_UART);			//Run UART task
		}
		else{
			pRx++;														//Increment the pointer address
			if(pRx >= &RX[49])								//Check for end of buffer
				pRx = &RX[0];										//If end of buffer, set ptr to front
		}
	}
}

void HardFault_Handler(void){
	__ASM volatile ("BKPT #01");					//If  debugger is connected and hardfault
	while(1);															//go here forever
}

////////////////////////////////////////////////////////////////////////////////////////////////////////////////////////////////////
/***************************************************** END FUNCTIONS **************************************************************/
////////////////////////////////////////////////////////////////////////////////////////////////////////////////////////////////////


////////////////////////////////////////////////////////////////////////////////////////////////////////////////////////////////////
/********************************************************* END IRQn.c *************************************************************/
////////////////////////////////////////////////////////////////////////////////////////////////////////////////////////////////////
